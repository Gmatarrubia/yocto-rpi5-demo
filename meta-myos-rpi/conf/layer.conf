## meta-myos-rpi/conf/layer.conf
```bitbake
# We have a conf and classes directory, append to BBPATH
BBPATH .= ":${LAYERDIR}"

# We have a recipes directory containing .bb and .bbappend files, add to BBFILES
BBFILES += "${LAYERDIR}/recipes*/*/*.bb \
            ${LAYERDIR}/recipes*/*/*.bbappend"

BBFILE_COLLECTIONS += "myos-rpi"
BBFILE_PATTERN_myos-rpi := "^${LAYERDIR}/"
BBFILE_PRIORITY_myos-rpi = "9"

LAYERSERIES_COMPAT_myos-rpi = "scarthgap"
LAYERDEPENDS_myos-rpi = "raspberrypi"

# Additional license directories.
#LICENSE_PATH += "${LAYERDIR}/files/custom-licenses"
```

## meta-myos/conf/distro/myos.conf
```bitbake
require conf/distro/include/config-file.conf
require conf/distro/include/versions.conf

# Distro settings
DISTRO = "myos"
DISTRO_NAME = "My Custom OS (Linux OS based on Poky.)"
DISTRO_VERSION = "1.0"
DISTRO_CODENAME = "scarthgap"
MAINTAINER = "Your name here"
hostname:pn-base-files = "myos"

# SDK configs
SDK_VENDOR = "-pokysdk"
SDK_VERSION = "${@d.getVar('DISTRO_VERSION').replace('snapshot-${METADATA_REVISION}', 'snapshot')}"
SDK_VERSION[vardepvalue] = "${SDK_VERSION}"

LINUX_KERNEL_TYPE = "preempt-rt"

# Distro features
DISTRO_FEATURES:remove = "sysvinit x11"
DISTRO_FEATURES:append = " usbhost pam systemd wifi"
DISTRO_FEATURES_BACKFILL_CONSIDERED = ""

# Init manager configs
INIT_MANAGER = "systemd"
VIRTUAL-RUNTIME:init_manager = "systemd"
VIRTUAL-RUNTIME:initscripts = ""

# Miscelanious Configs
IMAGE_LINGUAS = "en-US"

# ROOTFS Size configs
IMAGE_OVERHEAD_FACTOR="20.0"
# ROOTFS SIZE 10485760 = 10 * 1024 * 1024
ROOTFS_SIZE="10485760"
```

## meta-myos/conf/layer.conf
```bitbake
# We have a conf and classes directory, append to BBPATH
BBPATH .= ":${LAYERDIR}"

# We have a recipes directory containing .bb and .bbappend files, add to BBFILES
BBFILES += "${LAYERDIR}/recipes*/*/*.bb \
            ${LAYERDIR}/recipes*/*/*.bbappend"

BBFILE_COLLECTIONS += "myos"
BBFILE_PATTERN_myos := "^${LAYERDIR}/"
BBFILE_PRIORITY_myos = "9"

LAYERSERIES_COMPAT_myos = "scarthgap"

# Additional license directories.
#LICENSE_PATH += "${LAYERDIR}/files/custom-licenses"
```
